## boards/shields/oled_adapter/Kconfig.defconfig
```kconfig
# Copyright (c) 2022 The ZMK Contributors
# SPDX-License-Identifier: MIT

if SHIELD_OLED_ADAPTER_PRO_MICRO_128X32 || SHIELD_OLED_ADAPTER_PRO_MICRO_128X64 || SHIELD_OLED_ADAPTER_PRO_MICRO_128X128 || SHIELD_OLED_ADAPTER_SEEEDUINO_XIAO_BLE_128X32 || SHIELD_OLED_ADAPTER_SEEEDUINO_XIAO_BLE_128X64 || SHIELD_OLED_ADAPTER_SEEEDUINO_XIAO_BLE_128X128 || SHIELD_OLED_ADAPTER_PRO_MICRO_64X128 || SHIELD_OLED_ADAPTER_SEEEDUINO_XIAO_BLE_64X128

if ZMK_DISPLAY

config I2C
    default y

if SHIELD_OLED_ADAPTER_PRO_MICRO_128X32 || SHIELD_OLED_ADAPTER_PRO_MICRO_128X64 || SHIELD_OLED_ADAPTER_SEEEDUINO_XIAO_BLE_128X32 || SHIELD_OLED_ADAPTER_SEEEDUINO_XIAO_BLE_128X64

config SSD1306
    default y

endif

if SHIELD_OLED_ADAPTER_PRO_MICRO_128X128 || SHIELD_OLED_ADAPTER_SEEEDUINO_XIAO_BLE_128X128

config SH1106
    default y

endif

if SHIELD_OLED_ADAPTER_PRO_MICRO_64X128 || SHIELD_OLED_ADAPTER_SEEEDUINO_XIAO_BLE_64X128

config SH1107
    default y

endif

endif # ZMK_DISPLAY

endif
```
